## src/uarp/writer/mcuboot/Kconfig
```kconfig
#
# Copyright (c) 2024 Nordic Semiconductor
#
# SPDX-License-Identifier: LicenseRef-Nordic-4-Clause
#

config FMNA_UARP_WRITER_MCUBOOT
	bool "MCUboot-specific FMNA UARP payload writer"
	depends on BOOTLOADER_MCUBOOT
	select FLASH_MAP
	select FMNA_UARP_WRITER_UTIL_NVM
	select MCUBOOT_BOOTUTIL_LIB

if FMNA_UARP_WRITER_MCUBOOT

config FMNA_UARP_WRITER_MCUBOOT_BUF_SIZE
	int "Buffer size used for NVM writes to image slot"
	default 512
	range 256 4096
	help
	  Buffer size needed for NVM writes to image slot.

endif # FMNA_UARP_WRITER_MCUBOOT

module = FMNA_UARP_WRITER_MCUBOOT
module-str = fmna_uarp_writer_mcuboot
source "subsys/logging/Kconfig.template.log_config"
```

## src/uarp/writer/util/Kconfig
```kconfig
#
# Copyright (c) 2024 Nordic Semiconductor
#
# SPDX-License-Identifier: LicenseRef-Nordic-4-Clause
#

config FMNA_UARP_WRITER_UTIL_NVM
	bool "NVM management utility used by defined FMNA UARP payload writers"
	select FLASH_MAP
	select STREAM_FLASH
	select DFU_TARGET
	select DFU_TARGET_STREAM

module = FMNA_UARP_WRITER_UTIL_NVM
module-str = fmna_uarp_writer_util_nvm
source "subsys/logging/Kconfig.template.log_config"
```

## tests/crypto/testcase.yaml
```yaml
tests:
  test.find_my.crypto:
    sysbuild: true
    platform_allow:
      - nrf52dk/nrf52832
      - nrf52833dk/nrf52833
      - nrf52840dk/nrf52840
      - nrf5340dk/nrf5340/cpuapp
      - nrf5340dk/nrf5340/cpuapp/ns
      - nrf54l15dk/nrf54l15/cpuapp
      - nrf54h20dk/nrf54h20/cpuapp
    integration_platforms:
      - nrf52dk/nrf52832
      - nrf52833dk/nrf52833
      - nrf52840dk/nrf52840
      - nrf5340dk/nrf5340/cpuapp
      - nrf5340dk/nrf5340/cpuapp/ns
      - nrf54l15dk/nrf54l15/cpuapp
      - nrf54h20dk/nrf54h20/cpuapp
    tags:
      - sysbuild
      - find_my
```
