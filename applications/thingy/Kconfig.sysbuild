## applications/thingy/Kconfig.sysbuild
```kconfig
#
# Copyright (c) 2024 Nordic Semiconductor ASA
#
# SPDX-License-Identifier: LicenseRef-Nordic-4-Clause
#

config NRF_DEFAULT_IPC_RADIO
	default y if SOC_NRF5340_CPUAPP

config PM_EXTERNAL_FLASH_MCUBOOT_SECONDARY
	default n if BOOTLOADER_MCUBOOT

source "${ZEPHYR_BASE}/share/sysbuild/Kconfig"
```

## applications/thingy/boards/thingy53_nrf5340_cpuapp_ns_ZDebug.conf
```kconfig
#
# Copyright (c) 2024 Nordic Semiconductor
#
# SPDX-License-Identifier: LicenseRef-Nordic-4-Clause
#

# FMN configuration
CONFIG_FMNA_MODEL_NAME="Thingy53"

CONFIG_SPI=y
CONFIG_BMI270=y

# TF-M profile has to be properly configured to be able to run
# the Bluetooth stack which uses PSA crypto API.
# The following configuration is a minimal set of options required.
CONFIG_TFM_PROFILE_TYPE_NOT_SET=y

CONFIG_TFM_PARTITION_PLATFORM=y
CONFIG_TFM_PARTITION_CRYPTO=y
CONFIG_TFM_PARTITION_INTERNAL_TRUSTED_STORAGE=y
CONFIG_TFM_PARTITION_PROTECTED_STORAGE=n
CONFIG_TFM_PARTITION_INITIAL_ATTESTATION=n

CONFIG_PM_PARTITION_SIZE_TFM=0x17e00
```

## applications/thingy/sample.yaml
```yaml
sample:
  name: Find My Thingy
  description: Find My Thingy application
tests:
  application.find_my.thingy.release:
    sysbuild: true
    build_only: true
    platform_allow:
      - thingy53/nrf5340/cpuapp
      - thingy53/nrf5340/cpuapp/ns
    integration_platforms:
      - thingy53/nrf5340/cpuapp
      - thingy53/nrf5340/cpuapp/ns
    tags:
      - ci_build
      - sysbuild
      - find_my
    extra_args: FILE_SUFFIX=ZRelease
  application.find_my.thingy.debug:
    sysbuild: true
    build_only: true
    platform_allow:
      - thingy53/nrf5340/cpuapp
      - thingy53/nrf5340/cpuapp/ns
    integration_platforms:
      - thingy53/nrf5340/cpuapp
      - thingy53/nrf5340/cpuapp/ns
    tags:
      - ci_build
      - sysbuild
      - find_my
```

## samples/locator_tag/Kconfig.sysbuild
```kconfig
#
# Copyright (c) 2024 Nordic Semiconductor ASA
#
# SPDX-License-Identifier: LicenseRef-Nordic-4-Clause
#

config NRF_DEFAULT_IPC_RADIO
	default y if SOC_NRF5340_CPUAPP || SOC_NRF54H20_CPUAPP

choice BOOTLOADER
	default BOOTLOADER_MCUBOOT if !SOC_NRF54H20_CPUAPP
endchoice

source "${ZEPHYR_BASE}/share/sysbuild/Kconfig"
```

## samples/locator_tag/boards/nrf5340dk_nrf5340_cpuapp_ns.conf
```kconfig
#
# Copyright (c) 2024 Nordic Semiconductor
#
# SPDX-License-Identifier: LicenseRef-Nordic-4-Clause
#

# Disable unused Mbed TLS features
CONFIG_MBEDTLS_CIPHER_MODE_CBC=n
CONFIG_MBEDTLS_CIPHER_MODE_CTR=n
CONFIG_MBEDTLS_CIPHER_MODE_XTS=n
CONFIG_MBEDTLS_CMAC_C=n
CONFIG_MBEDTLS_CCM_C=n
CONFIG_MBEDTLS_CHACHA20_C=n
CONFIG_MBEDTLS_POLY1305_C=n

# Disable the default MCUboot child image configuration
CONFIG_PM_EXTERNAL_FLASH_MCUBOOT_SECONDARY=n
CONFIG_NRF53_UPGRADE_NETWORK_CORE=n

# TF-M profile has to be properly configured to be able to run
# the Bluetooth stack which uses PSA crypto API.
# The following configuration is a minimal set of options required.
CONFIG_TFM_PROFILE_TYPE_NOT_SET=y

CONFIG_TFM_PARTITION_PLATFORM=y
CONFIG_TFM_PARTITION_CRYPTO=y
CONFIG_TFM_PARTITION_INTERNAL_TRUSTED_STORAGE=y
CONFIG_TFM_PARTITION_PROTECTED_STORAGE=n
CONFIG_TFM_PARTITION_INITIAL_ATTESTATION=n

CONFIG_PM_PARTITION_SIZE_TFM=0x17e00
```

## samples/locator_tag/boards/nrf54h20dk_nrf54h20_cpuapp.conf
```kconfig
#
# Copyright (c) 2025 Nordic Semiconductor
#
# SPDX-License-Identifier: LicenseRef-Nordic-4-Clause
#

# DFU using UARP protocol is currently not supported for devices that uses SUIT,
# such as nRF54H20 SoC.
CONFIG_FMNA_CAPABILITY_FW_UPDATE_ENABLED=n

# MCUboot is not supported on the nRF54H20 SoC.
CONFIG_MCUBOOT_IMGTOOL_SIGN_VERSION=""

# FMN Firmware version
CONFIG_FMNA_FIRMWARE_VERSION_MAJOR=1
CONFIG_FMNA_FIRMWARE_VERSION_MINOR=0
CONFIG_FMNA_FIRMWARE_VERSION_REVISION=0

# nRF54H-specific power management configuration
CONFIG_PM=y
```

## samples/locator_tag/sample.yaml
```yaml
sample:
  name: Find My Locator tag
  description: Find My Locator tag sample
tests:
  sample.find_my.locator_tag.release:
    sysbuild: true
    build_only: true
    platform_allow:
      - nrf52dk/nrf52832
      - nrf52833dk/nrf52833
      - nrf52840dk/nrf52840
      - nrf5340dk/nrf5340/cpuapp
      - nrf5340dk/nrf5340/cpuapp/ns
      - nrf54l15dk/nrf54l15/cpuapp
      - nrf54h20dk/nrf54h20/cpuapp
    integration_platforms:
      - nrf52dk/nrf52832
      - nrf52833dk/nrf52833
      - nrf52840dk/nrf52840
      - nrf5340dk/nrf5340/cpuapp
      - nrf5340dk/nrf5340/cpuapp/ns
      - nrf54l15dk/nrf54l15/cpuapp
      - nrf54h20dk/nrf54h20/cpuapp
    tags:
      - ci_build
      - sysbuild
      - find_my
    extra_args: FILE_SUFFIX=ZRelease
  sample.find_my.locator_tag.debug:
    sysbuild: true
    build_only: true
    platform_allow:
      - nrf52840dk/nrf52840
      - nrf5340dk/nrf5340/cpuapp
      - nrf5340dk/nrf5340/cpuapp/ns
      - nrf54l15dk/nrf54l15/cpuapp
      - nrf54h20dk/nrf54h20/cpuapp
    integration_platforms:
      - nrf52840dk/nrf52840
      - nrf5340dk/nrf5340/cpuapp
      - nrf5340dk/nrf5340/cpuapp/ns
      - nrf54l15dk/nrf54l15/cpuapp
      - nrf54h20dk/nrf54h20/cpuapp
    tags:
      - ci_build
      - sysbuild
      - find_my
  sample.find_my.locator_tag.qualification.release:
    sysbuild: true
    build_only: true
    platform_allow:
      - nrf52dk/nrf52832
      - nrf52833dk/nrf52833
      - nrf52840dk/nrf52840
      - nrf5340dk/nrf5340/cpuapp
      - nrf5340dk/nrf5340/cpuapp/ns
      - nrf54l15dk/nrf54l15/cpuapp
      - nrf54h20dk/nrf54h20/cpuapp
    integration_platforms:
      - nrf52dk/nrf52832
      - nrf52833dk/nrf52833
      - nrf52840dk/nrf52840
      - nrf5340dk/nrf5340/cpuapp
      - nrf5340dk/nrf5340/cpuapp/ns
      - nrf54l15dk/nrf54l15/cpuapp
      - nrf54h20dk/nrf54h20/cpuapp
    tags:
      - ci_build
      - sysbuild
      - find_my
    extra_args: FILE_SUFFIX=ZRelease
    extra_configs:
      - CONFIG_FMNA_QUALIFICATION=y
  sample.find_my.locator_tag.qualification.debug:
    sysbuild: true
    build_only: true
    platform_allow:
      - nrf52840dk/nrf52840
      - nrf5340dk/nrf5340/cpuapp
      - nrf5340dk/nrf5340/cpuapp/ns
      - nrf54l15dk/nrf54l15/cpuapp
      - nrf54h20dk/nrf54h20/cpuapp
    integration_platforms:
      - nrf52840dk/nrf52840
      - nrf5340dk/nrf5340/cpuapp
      - nrf5340dk/nrf5340/cpuapp/ns
      - nrf54l15dk/nrf54l15/cpuapp
      - nrf54h20dk/nrf54h20/cpuapp
    tags:
      - ci_build
      - sysbuild
      - find_my
    extra_configs:
      - CONFIG_FMNA_QUALIFICATION=y
```

## samples/locator_tag/sysbuild/ipc_radio/boards/nrf54h20dk_nrf54h20_cpurad.conf
```kconfig
#
# Copyright (c) 2025 Nordic Semiconductor
#
# SPDX-License-Identifier: LicenseRef-Nordic-4-Clause
#

# nRF54H-specific power management configuration
CONFIG_PM=y

# Bluetooth stack with SoftDevice Link Layer requires high frequency in Global Domain (GD)
# to make L2 cache and MRAM run fast to avoid code execution delays.
CONFIG_CLOCK_CONTROL_NRF2_GLOBAL_HSFLL_REQ_LOW_FREQ=n
```

## samples/locator_tag/sysbuild/mcuboot/boards/nrf5340dk_nrf5340_cpuapp_ZRelease.conf
```kconfig
#
# Copyright (c) 2022 Nordic Semiconductor
#
# SPDX-License-Identifier: LicenseRef-Nordic-4-Clause
#

# Align the MCUboot partition size with the requirement for
# the 4-page partition alignment.
CONFIG_PM_PARTITION_SIZE_MCUBOOT=0x8000

# CC3xx is currently not used for nrf53
CONFIG_HW_CC3XX=n
CONFIG_NRF_CC3XX_PLATFORM=n

# Required for kernel operation
CONFIG_CLOCK_CONTROL=y
CONFIG_SYS_CLOCK_EXISTS=y
```

## samples/locator_tag/sysbuild/mcuboot/boards/nrf5340dk_nrf5340_cpuapp_ns_ZDebug.conf
```kconfig
#
# Copyright (c) 2023 Nordic Semiconductor
#
# SPDX-License-Identifier: LicenseRef-Nordic-4-Clause
#

# Align the MCUboot partition size with the requirement for
# the 4-page partition alignment.
CONFIG_PM_PARTITION_SIZE_MCUBOOT=0x10000
```

## samples/locator_tag/sysbuild/mcuboot/boards/nrf54l15dk_nrf54l15_cpuapp_ZDebug.conf
```kconfig
#
# Copyright (c) 2024 Nordic Semiconductor
#
# SPDX-License-Identifier: LicenseRef-Nordic-4-Clause
#

CONFIG_BOOT_MAX_IMG_SECTORS=256

# Disable the unused SPI NOR driver that causes build failures due to missing DTS configuration.
CONFIG_SPI_NOR=n
```

## samples/locator_tag/sysbuild/mcuboot/boards/nrf54l15dk_nrf54l15_cpuapp_ZRelease.conf
```kconfig
#
# Copyright (c) 2024 Nordic Semiconductor
#
# SPDX-License-Identifier: LicenseRef-Nordic-4-Clause
#

CONFIG_PM_PARTITION_SIZE_MCUBOOT=0x7000

CONFIG_BOOT_MAX_IMG_SECTORS=256

# Disable the unused SPI NOR driver that causes build failures due to missing DTS configuration.
CONFIG_SPI_NOR=n

# Optimize memory usage (Locator tag disables system clock for MCUboot image).
CONFIG_NRF_GRTC_TIMER=n
CONFIG_NRF_GRTC_START_SYSCOUNTER=n
```

## samples/pair_before_use/Kconfig.sysbuild
```kconfig
#
# Copyright (c) 2024 Nordic Semiconductor ASA
#
# SPDX-License-Identifier: LicenseRef-Nordic-4-Clause
#

config NRF_DEFAULT_IPC_RADIO
	default y if SOC_NRF5340_CPUAPP || SOC_NRF54H20_CPUAPP

source "${ZEPHYR_BASE}/share/sysbuild/Kconfig"
```

## samples/pair_before_use/boards/nrf54h20dk_nrf54h20_cpuapp.conf
```kconfig
#
# Copyright (c) 2025 Nordic Semiconductor
#
# SPDX-License-Identifier: LicenseRef-Nordic-4-Clause
#

# nRF54H-specific power management configuration
CONFIG_PM=y
```

## samples/pair_before_use/sample.yaml
```yaml
sample:
  name: Find My Pair before use
  description: Find My Pair before use sample
tests:
  sample.find_my.pair_before_use.release:
    sysbuild: true
    build_only: true
    platform_allow:
      - nrf52dk/nrf52832
      - nrf52833dk/nrf52833
      - nrf52840dk/nrf52840
      - nrf5340dk/nrf5340/cpuapp
      - nrf5340dk/nrf5340/cpuapp/ns
      - nrf54l15dk/nrf54l15/cpuapp
      - nrf54h20dk/nrf54h20/cpuapp
    integration_platforms:
      - nrf52dk/nrf52832
      - nrf52833dk/nrf52833
      - nrf52840dk/nrf52840
      - nrf5340dk/nrf5340/cpuapp
      - nrf5340dk/nrf5340/cpuapp/ns
      - nrf54l15dk/nrf54l15/cpuapp
      - nrf54h20dk/nrf54h20/cpuapp
    tags:
      - ci_build
      - sysbuild
      - find_my
    extra_args: FILE_SUFFIX=ZRelease
  sample.find_my.pair_before_use.debug:
    sysbuild: true
    build_only: true
    platform_allow:
      - nrf52dk/nrf52832
      - nrf52833dk/nrf52833
      - nrf52840dk/nrf52840
      - nrf5340dk/nrf5340/cpuapp
      - nrf5340dk/nrf5340/cpuapp/ns
      - nrf54l15dk/nrf54l15/cpuapp
      - nrf54h20dk/nrf54h20/cpuapp
    integration_platforms:
      - nrf52dk/nrf52832
      - nrf52833dk/nrf52833
      - nrf52840dk/nrf52840
      - nrf5340dk/nrf5340/cpuapp
      - nrf5340dk/nrf5340/cpuapp/ns
      - nrf54l15dk/nrf54l15/cpuapp
      - nrf54h20dk/nrf54h20/cpuapp
    tags:
      - ci_build
      - sysbuild
      - find_my
```

## samples/switchable_networks/Kconfig
```kconfig
#
# Copyright (c) 2025 Nordic Semiconductor
#
# SPDX-License-Identifier: LicenseRef-Nordic-4-Clause
#

menu "Switchable Networks sample"

rsource "src/dfu/Kconfig"

config APP_NETWORK_BT_ID
	int "Bluetooth identity used by the selected network"
	default 1
	help
	  Select the Bluetooth identity used for the networks.
	  When choosing the network, the Bluetooth identity shall be used only
	  for the selected network. When switching the network, this Bluetooth
	  identity must be reset using the bt_id_reset to ensure that there
	  will be no persistent data left from the previous network.
	  The Bluetooth identity must be smaller than BT_ID_MAX.

endmenu

source "Kconfig.zephyr"
```

## samples/switchable_networks/Kconfig.sysbuild
```kconfig
#
# Copyright (c) 2025 Nordic Semiconductor
#
# SPDX-License-Identifier: LicenseRef-Nordic-4-Clause
#

config BT_FAST_PAIR
	default y

config APP_DFU
	bool "Enable MCUmgr OTA DFU over Bluetooth"
	default y
	depends on BOOTLOADER_MCUBOOT
	help
	  This option enables the DFU functionality in this application.
	  The DFU solution is supported for the MCUboot-based targets.

source "${ZEPHYR_BASE}/share/sysbuild/Kconfig"
```

## samples/switchable_networks/configuration/boards/nrf52833dk_nrf52833_ZDebug.conf
```kconfig
#
# Copyright (c) 2025 Nordic Semiconductor
#
# SPDX-License-Identifier: LicenseRef-Nordic-4-Clause
#

# Bootloader is not used
CONFIG_MCUBOOT_BOOTUTIL_LIB=n
```

## samples/switchable_networks/sample.yaml
```yaml
sample:
  name: Switchable Networks
  description: Switchable Networks sample
tests:
  sample.find_my.switchable_networks.release:
    sysbuild: true
    build_only: true
    platform_allow:
      - nrf52833dk/nrf52833
      - nrf52840dk/nrf52840
      - nrf54l15dk/nrf54l15/cpuapp
    integration_platforms:
      - nrf52833dk/nrf52833
      - nrf52840dk/nrf52840
      - nrf54l15dk/nrf54l15/cpuapp
    tags:
      - ci_build
      - sysbuild
      - find_my
    extra_args: FILE_SUFFIX=ZRelease
  sample.find_my.switchable_networks.debug:
    sysbuild: true
    build_only: true
    platform_allow:
      - nrf52833dk/nrf52833
      - nrf52840dk/nrf52840
      - nrf54l15dk/nrf54l15/cpuapp
    integration_platforms:
      - nrf52833dk/nrf52833
      - nrf52840dk/nrf52840
      - nrf54l15dk/nrf54l15/cpuapp
    tags:
      - ci_build
      - sysbuild
      - find_my
```

## samples/switchable_networks/src/dfu/Kconfig
```kconfig
#
# Copyright (c) 2025 Nordic Semiconductor
#
# SPDX-License-Identifier: LicenseRef-Nordic-4-Clause
#

config APP_DFU
	bool "Enable MCUmgr OTA DFU over Bluetooth"
	select NCS_SAMPLE_MCUMGR_BT_OTA_DFU
	select MCUMGR_MGMT_NOTIFICATION_HOOKS
	select MCUMGR_GRP_IMG_STATUS_HOOKS
	depends on BOOTLOADER_MCUBOOT
	help
	  Enable support for Device Firmware Update (DFU) over MCUmgr & SMP BT.

config APP_DFU_BT_ID
	int "Bluetooth identity used by the DFU module"
	default 0
	help
	  Select the Bluetooth identity used for the DFU.
	  The Bluetooth identity must be smaller than BT_ID_MAX.

if APP_DFU

config MCUMGR_TRANSPORT_BT_DYNAMIC_SVC_REGISTRATION
	default n

# Do not allow for settings erase through MCUmgr.
# It prevents the accidental erasure of the Apple Find My provisioning data.
config MCUMGR_GRP_ZBASIC
	default n

config MCUMGR_GRP_ZBASIC_STORAGE_ERASE
	default n

endif # APP_DFU
```
